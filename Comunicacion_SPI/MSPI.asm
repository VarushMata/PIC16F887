	PROCESSOR	P16F887
	INCLUDE		<P16F887.INC>

__CONFIG _CONFIG1, (_INTRC_OSC_NOCLKOUT & _WDT_OFF & _PWRTE_OFF & _MCLRE_OFF & _CP_OFF & _CPD_OFF & _BOR_OFF & _IESO_OFF & _FCMEN_OFF & _LVP_OFF & _DEBUG_OFF)
__CONFIG _CONFIG2, (_WRT_OFF & _BOR40V)

MX		EQU		0x20
VT		EQU		0x21
E1		EQU		0x22
E2		EQU		0x23
E3		EQU		0x24
E4		EQU		0x25
E5		EQU		0x26
M1		EQU		0x27
M2		EQU		0x28
M3		EQU		0x29
M4		EQU		0x30
M5		EQU		0x31
VX		EQU		0x32

		ORG	0x00
 
		BANKSEL	ANSEL
		CLRF	ANSELH
		MOVLW	0x60
		MOVWF	ANSEL

		BANKSEL	TRISA
;CONFIGURO ENTRADAS Y SALIDAS
		MOVLW	0xFF
		MOVWF	TRISB	;PUERTO B ENTRADA SW
		CLRF	TRISA	;PUERTO A SALIDA BL
		MOVLW	0x10	;0001 0000
		MOVWF	TRISC	;SDI ENTRADA. SDO,SCK,CCP1 Y CCP2 SALIDAS 
		MOVLW	0x00
		MOVWF	TRISD
;CONFIGURO EL ADC
		MOVLW	0x03
		MOVWF	TRISE	;ACTIVO CANAL 5 Y 6
		CLRF	ADCON1
;CONFIGURO EL RETARDO
		MOVLW	0xD0
		MOVWF	OPTION_REG	;PRESCALADOR TIMER0 EN 2us
;CONFIGURO EL PWM
		MOVLW	0xFF	;AJUSTO PR2 A 255 	
		MOVWF	PR2
;COMUNICACION SPI
		MOVLW	0x00
		MOVWF	SSPCON2	;I2C
		MOVLW	0xC0	;1100 0000
		MOVWF	SSPSTAT	;BITS TRANSMITIDOS AL INICIO DE SCK

		BANKSEL	PORTA
		MOVLW	0x80
		MOVWF	CCPR2L	;AJUSTO DUTY CYCLE CON VC5
		MOVWF	CCPR1L	;AJUSTO DUTY CYCLE CON VC6

		MOVLW	0x0C
		MOVWF	CCP1CON
		MOVWF	CCP2CON
		BSF		PORTD,RD7

		BSF		T2CON,0	;PRESCALADOR EN 16
		BSF		T2CON,1
		
		BCF		PIR1,TMR2IF
		BSF		T2CON,TMR2ON ;ENCIENDO TMR2
W1		BTFSS	PIR1,TMR2IF
		GOTO	W1

		MOVLW	0x30	;0011 0000
		MOVWF	SSPCON	;ACTIVA PUERTOS SERIALES

		CALL	RET

C_P		MOVF	PORTB,W	;GUARDO LA ENTRADA DEL PUERTO B EN M1
		MOVWF	M1

		MOVLW	0xD5	;ACTIVO CANAL 5
		MOVWF	ADCON0	
		BSF		ADCON0,GO_DONE	;EMPIEZO CONVERSION
LC5		BTFSC	ADCON0,GO_DONE
		GOTO	LC5
		MOVF	ADRESH,W
		MOVWF	M2	;GUARDO 8 BITS EN M2
		CALL	L2B
		MOVWF	M3	;GUARDO 2 BITS EN M3

		BCF		ADCON0,ADON	;APAGO ADC
		CALL	RET

		MOVLW	0xD9	;ACTIVO CANAL 6
		MOVWF	ADCON0
		BSF		ADCON0,GO_DONE	;EMPIEZO CONVERSION
LC6		BTFSC	ADCON0,GO_DONE
		GOTO	LC6
		MOVF	ADRESH,W
		MOVWF	M4	;GUARDO 8 BITS EN M4
		CALL	L2B
		MOVWF	M5	;GUARDO 2 BITS EN M5

		BCF		ADCON0,ADON
		CALL	RET

		MOVF	E1,W	;SACO EL DATO RECIBIDO E1 AL PUERTO A
		MOVWF	PORTA
		CALL	RET

		MOVF	E2,W	;GENERO EL PWM1 CON LOS DATOS RECIBIDOS
		MOVWF	CCPR1L
		MOVF	E3,W
		MOVWF	CCP1CON
		CALL	RET

		MOVF	E4,W	;GENERO EL PWM2 CON LOS DATOS RECIBIDOS
		MOVWF	CCPR2L
		MOVF	E5,W
		MOVWF	CCP2CON
		CALL 	RET

;EMPIEZO A MANDAR LOS DATOS AL ESCLAVO

		MOVF	M1,W	;ENVIO LA ENTRADA M1
		CALL	MASTER
		MOVWF	MX		;RECIBO DATOS QUE NO USO Y GUARDO EN MX
	
		MOVF	M2,W	;MANDO M2
		CALL	MASTER
		MOVWF	E1	;RECIBO E1

		MOVF	M3,W	;MANDO M3
		CALL	MASTER
		MOVWF	E2	;RECIBO E2

		MOVF	M4,W	;MANDO M4
		CALL	MASTER
		MOVWF	E3	;RECIBO E3

		MOVF	M5,W	;MANDO M5
		CALL	MASTER
		MOVWF	E4	;RECIBO E4

		MOVF	MX,W	;MANDO BASURA DE MX
		CALL	MASTER
		MOVWF	E5	;RECIBO E5
	
		CALL	RET
		GOTO	C_P

MASTER	BCF		PORTD,RD7	;LIMPIO SS PARA INICIAR COMUNICACION
		MOVWF	SSPBUF	;MANDO M1 AL ESCLAVO
		BANKSEL	TRISA
BFL		BTFSS	SSPSTAT,BF	;ESPERO A QUE EL BUFFER SE LLENE
		GOTO	BFL
		BANKSEL PORTA
		MOVF	SSPBUF,W	;LEO LOS DATOS RECIBIDOS DEL ESCLAVO
		MOVWF	VX
		BSF		PORTD,RD7	;PONGO SS EN 1 PARA TERMINAR LA COMUNIACION
		CALL	RET
		MOVF	VX,W
		RETURN	

L2B		
		BANKSEL	TRISA
		MOVF	ADRESL,W
		BANKSEL	PORTA
		MOVWF	VT
		BCF		STATUS,C
		RRF		VT,F
		RRF		VT,F
		MOVLW	0x0C
		IORWF	VT,W
		RETURN

RET		MOVLW	0xD5
		MOVWF	TMR0	;PRESCALADOR 16us, TIMER0 62, TOTAL 3.113ms
EDT0	BTFSS	INTCON,T0IF
		GOTO 	EDT0
		BCF		INTCON,T0IF
		RETURN	

		END	