	PROCESSOR	P16F887
	INCLUDE		<P16F887.INC>

__CONFIG _CONFIG1, (_INTRC_OSC_NOCLKOUT & _WDT_OFF & _PWRTE_OFF & _MCLRE_OFF & _CP_OFF & _CPD_OFF & _BOR_OFF & _IESO_OFF & _FCMEN_OFF & _LVP_OFF & _DEBUG_OFF)
__CONFIG _CONFIG2, (_WRT_OFF & _BOR40V)

EX		EQU		0x20
X1		EQU		0x21
X2		EQU		0x22
E1		EQU		0x23
E2		EQU		0x24
E3		EQU		0x25
E4		EQU		0x26
E5		EQU		0x27
M1		EQU		0x28
M2		EQU		0x29
M3		EQU		0x30
M4		EQU		0x31
M5		EQU		0x32
VT		EQU		0x33


		ORG	0x00
 
		BANKSEL	ANSEL
		CLRF	ANSELH
		MOVLW	0x60
		MOVWF	ANSEL

		BANKSEL	TRISA
;CONFIGURO ENTRADAS Y SALIDAS
		MOVLW	0xFF
		MOVWF	TRISB	;PUERTO B ENTRADA SW
		MOVLW	0x20	;0010 0000
		MOVWF	TRISA	;ACTIVO RA5 COMO SS
		MOVLW	0x18	;0001 1000
		MOVWF	TRISC	;SDI Y SCK ENTRADAS. SDO,CCP1 Y CCP2 SALIDAS 
		MOVLW	0xFF
		MOVWF	TRISD
;CONFIGURO EL ADC
		MOVLW	0x03
		MOVWF	TRISE	;ACTIVO CANAL 5 Y 6
		CLRF	ADCON1
;CONFIGURO EL RETARDO
		MOVLW	0xD0
		MOVWF	OPTION_REG	;PRESCALADOR TIMER0 EN 2us
;CONFIGURO EL PWM
		MOVLW	0xFF	;AJUSTO PR2 A 255 	
		MOVWF	PR2
;COMUNICACION SP1
		MOVLW	0x00
		MOVWF	SSPCON2	;I2C
		MOVLW	0x40	;0100 0000
		MOVWF	SSPSTAT	;BITS TRANSMITIDOS AL FINAL DE SCK

		BANKSEL	PORTA
		MOVLW	0x80
		MOVWF	CCPR2L
		MOVWF	CCPR1L

		MOVLW	0x0C	;ACTIVO MODO PWM
		MOVWF	CCP1CON
		MOVWF	CCP2CON

		BSF		T2CON,0	;PRESCALADOR EN 16
		BSF		T2CON,1
		
		BCF		PIR1,TMR2IF
		BSF		T2CON,TMR2ON	;ENCIENDO TMR2
W1		BTFSS	PIR1,TMR2IF
		GOTO	W1

		MOVLW	0x34	;0011 0101 SS COMO I/O PIN
		MOVWF	SSPCON	;ACTIVA PUERTOS SERIALES
	
		CALL	RET
C_P		MOVF	PORTB,W	;LEO LAS ENTRADAS DEL PUERTO B
		MOVWF	M1	;GUARDO EN M1

		MOVLW	0xD5	;ACTIVO CANAL 5
		MOVWF	ADCON0	
		BSF		ADCON0,GO_DONE	;EMPIEZO CONVERSION
LC5		BTFSC	ADCON0,GO_DONE
		GOTO	LC5
		MOVF	ADRESH,W
		MOVWF	M2	;GUARDO 8 BITS EN M2
		CALL	L2B
		MOVWF	M3	;GUARDO 2 BITS EN M3

		BCF		ADCON0,ADON	;APAGO ADC
		CALL	RET

		MOVLW	0xD9	;ACTIVO CANAL 6
		MOVWF	ADCON0
		BSF		ADCON0,GO_DONE	;EMPIEZO CONVERSION
LC6		BTFSC	ADCON0,GO_DONE
		GOTO	LC6
		MOVF	ADRESH,W
		MOVWF	M4	;GUARDO 8 BITS EN M4
		CALL	L2B
		MOVWF	M5	;GUARDO 8 BITS EN M5

		BCF		ADCON0,ADON
		CALL	RET

		MOVF	E1,W	;SACO EL DATO RECIBIDO E1 AL PUERTO A
		MOVWF	PORTA

		MOVF	E2,W	;GENERO PWM1 CON E2 Y E3
		MOVWF	CCPR1L
		MOVF	E3,W	
		MOVWF	CCP1CON

		MOVF	E4,W	;GENERO PWM2 CON E4 Y E5
		MOVWF	CCPR2L
		MOVF	E5,W
		MOVWF	CCP2CON

;EMPIEZO LA TRANSMISION CON EL MAESTRO

		MOVF	M1,W	;ENVIO M1
		CALL	SLAVE
		MOVWF	E1	;GUARDO EL VALOR RECIBIDO EN E1
		
		MOVF	M2,W	;ENVIO M2
		CALL	SLAVE
		MOVWF	E2	;GUARDO EL VALOR RECIBIDO EN E2

		MOVF	M3,W	;ENVIO M3
		CALL	SLAVE
		MOVWF	E3	;GUARDO EL VALOR RECIBIDO EN E3

		MOVF	M4,W	;ENVIO M4
		CALL	SLAVE
		MOVWF	E4	;GUARDO EL VALOR RECIBIDO EN E4

		MOVF	M5,W	;ENVIO M5
		CALL	SLAVE
		MOVWF	E5	;GUARDO EL VALOR RECIBIDO EN E5

		MOVF	EX,W	;ENVIO M5
		CALL	SLAVE
		MOVWF	EX	;GUARDO BASURA EN EX


		GOTO	C_P

SLAVE	MOVWF	X1	
		BANKSEL	TRISA
SL		BTFSS	SSPSTAT,BF	;ESPERO A QUE EL BUFFER SE LLENE
		GOTO	SL
		BANKSEL	PORTA
		MOVF	SSPBUF,W	;LEO EL VALOR ENVIADO POR EL MAESTRO
		MOVWF	X2		;GUARDO EN X2
		MOVF	X1,W
		MOVWF	SSPBUF	;MANDO X1 AL MAESTRO
		MOVF	X2,W	;MUEVO EL VALOR ENVIADO A W
		RETURN

L2B		
		BANKSEL	TRISA
		MOVF	ADRESL,W
		BANKSEL	PORTA
		MOVWF	VT
		BCF		STATUS,C
		RRF		VT,F
		RRF		VT,F
		MOVLW	0x0C
		IORWF	VT,W
		RETURN


RET		MOVLW	0xD5
		MOVWF	TMR0	;PRESCALADOR 16us, TIMER0 62, TOTAL 3.113ms
EDT0	BTFSS	INTCON,T0IF
		GOTO 	EDT0
		BCF		INTCON,T0IF
		RETURN	

		END	