PROCESSOR	P16F887
	INCLUDE		<P16F887.INC>

__CONFIG _CONFIG1, (_INTRC_OSC_NOCLKOUT & _WDT_OFF & _PWRTE_OFF & _MCLRE_OFF & _CP_OFF & _CPD_OFF & _BOR_OFF & _IESO_OFF & _FCMEN_OFF & _LVP_OFF & _DEBUG_OFF)
__CONFIG _CONFIG2, (_WRT_OFF & _BOR40V)

CONT		EQU	0x20

			ORG		0x00
			GOTO	INICIO
			ORG		0x04
			GOTO	S_AI
		
INICIO:		ORG		0x05
			
			BANKSEL	ANSEL
			CLRF	ANSEL
			CLRF	ANSELH
	
			BANKSEL	TRISA
			CLRF	TRISA
			MOVLW	B'00000011'
			MOVWF	TRISB
			CLRF	TRISC
			CLRF	TRISD
			CLRF	TRISE
			MOVLW	0xD7
			MOVWF	OPTION_REG

			BANKSEL	PORTA
			CLRF	PORTA
			MOVLW	D'16'
			MOVWF	CONT
			MOVLW	B'10100000'
			MOVWF	INTCON
			MOVLW	D'12'
			MOVWF	TMR0

C_P:		BTFSS	PORTB,RB0
			GOTO	C_RA0
			BSF		PORTA,RA0
			GOTO	E_RB1
C_RA0:		BCF		PORTA,RA0
E_RB1:		BTFSS	PORTB,RB1
			GOTO	C_RA1
			BSF		PORTA,RA1
			GOTO	C_P
C_RA1:		BCF		PORTA,RA1
			GOTO	C_P
			
S_AI:		MOVLW	B'10100000'
			MOVWF	INTCON
			MOVLW	D'12'
			MOVWF	TMR0
			DECFSZ	CONT,F
			GOTO	F_AI
			
			MOVLW	D'16'
			MOVWF	CONT
			BTFSS	PORTA,RA7
			GOTO	S_RB7
			BCF		PORTA,RA7
			GOTO	F_AI
S_RB7:		BSF		PORTA,RB7
F_AI:		RETFIE

			END
			
		