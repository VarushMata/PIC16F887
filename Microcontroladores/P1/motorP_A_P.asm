PROCESSOR	P16F887
		INCLUDE		<P16F887.INC>
		__CONFIG _CONFIG1, (_INTRC_OSC_NOCLKOUT & _WDT_OFF & _PWRTE_OFF & _MCLRE_OFF & _CP_OFF & _CPD_OFF & _BOR_OFF & _IESO_OFF & _FCMEN_OFF & _LVP_OFF & _DEBUG_OFF)
		__CONFIG _CONFIG2, (_WRT_OFF & _BOR40V)

VA		EQU	0x20	;ETIQUETAR RPG
NB		EQU	0x21
NA		EQU	0x22
RX		EQU	0x23
CX		EQU	0x24
XA		EQU	0x25
XB		EQU	0x26
VB		EQU	0x27
VC		EQU	0x28
XV		EQU	0x29
XC		EQU	0x30
     
		ORG	0x00	;VECTOR RESTAURACION
	
        BANKSEL ANSEL	;CAMBIO BANCO 3
.
		CLRF 	ANSEL
		CLRF 	ANSELH
	
		BANKSEL	TRISA	;CAMBIO BANCO 1
		MOVLW	0xFF
		MOVWF	TRISB
		CLRF	TRISC
		CLRF	TRISA
		CLRF	TRISD
		CLRF	TRISE
	
		BANKSEL	PORTA	;CAMBIO BANCO 0

C_P:	MOVF	PORTB,W
		ANDLW	0x7F
		MOVWF	XV
	
		MOVLW	0x7F
		XORWF	XV,W
		BTFSC	STATUS,Z
		GOTO	V7
	
		MOVLW	0x3F
		XORWF	XV,W
		BTFSC	STATUS,Z
		GOTO	V6
	
		MOVLW	0x1F
		XORWF	XV,W
		BTFSC	STATUS,Z
		GOTO	V5
	
		MOVLW	0x0F
		XORWF	XV,W
		BTFSC	STATUS,Z
		GOTO	V4
	
		MOVLW	0x07
		XORWF	XV,W
		BTFSC	STATUS,Z
		GOTO	V3
	
		MOVLW	0x03
		XORWF	XV,W
		BTFSC	STATUS,Z
		GOTO	V2

		MOVLW	0x01
		XORWF	XV,W
		BTFSC	STATUS,Z
		GOTO	V1

V0:		MOVLW	0xDB
		GOTO	NXC
		
V1:		MOVLW	0xC8
		GOTO	NXC
	
V2:		MOVLW	0xB7
		GOTO	NXC

V3:		MOVLW	0x93
		GOTO	NXC
	
V4:		MOVLW	0x40
		GOTO	NXC
	
V5:		MOVLW	0x20
		GOTO	NXC
	
V6:		MOVLW	0x10
		GOTO	NXC
	
V7:		MOVLW	0x08
		GOTO	NXC

NXC:	MOVWF	XC
		BTFSS	PORTB,RB7
		GOTO	GIX
		MOVLW	0x01
		MOVWF	PORTA
		CALL	RET
		MOVLW	0x02
		MOVWF	PORTA	
		CALL	RET
		MOVLW	0x04
		MOVWF	PORTA
		CALL	RET
		MOVLW	0x08
		MOVWF	PORTA
		CALL	RET
		GOTO	C_P

GIX:	MOVLW	0x08
		MOVWF	PORTA
		CALL	RET
		MOVLW	0x04
		MOVWF	PORTA	
		CALL	RET
		MOVLW	0x02
		MOVWF	PORTA
		CALL	RET
		MOVLW	0x01
		MOVWF	PORTA
		CALL	RET
		GOTO	C_P

RET:	MOVF	    XC,W
		MOVWF	    VC
C_C:	MOVLW	    0x08
		MOVWF	    VB
C_B:	MOVLW	   	0x03
		MOVWF	    VA	
C_A:	NOP
		NOP
		DECFSZ	    VA,F
		GOTO	    C_A
		DECFSZ	    VB,F
		GOTO	    C_B
		DECFSZ	    VC,F
		GOTO	    C_C
		RETURN
		END