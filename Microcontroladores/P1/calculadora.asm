		PROCESSOR	P16F887
		INCLUDE		<P16F887.INC>
		__CONFIG _CONFIG1, (_INTRC_OSC_NOCLKOUT & _WDT_OFF & _PWRTE_OFF & _MCLRE_OFF & _CP_OFF & _CPD_OFF & _BOR_OFF & _IESO_OFF & _FCMEN_OFF & _LVP_OFF & _DEBUG_OFF)
		__CONFIG _CONFIG2, (_WRT_OFF & _BOR40V)

VA		EQU	0x20	;ETIQUETAR RPG
NB		EQU	0x21
NA		EQU	0x22
RX		EQU	0x23
OPX		EQU	0x24
XA		EQU	0x25
XB		EQU	0x26
     
		ORG	0x00	;VECTOR RESTAURACION
	
        BANKSEL ANSEL	;CAMBIO BANCO 3
		CLRF 	ANSEL
		CLRF 	ANSELH
	
		BANKSEL	TRISA	;CAMBIO BANCO 1
		MOVLW	0xFF
		MOVWF	TRISB
		MOVLW	0xFF
		MOVWF	TRISC
		CLRF	TRISA
		CLRF	TRISD
		CLRF	TRISE
	
		BANKSEL	PORTA	;CAMBIO BANCO 0
		
C_P:	MOVF	PORTB,W
		MOVWF	VA
		ANDLW	0x0F
		MOVWF	NB
		MOVF	VA,W
		ANDLW	0xF0
		MOVWF	NA
		SWAPF	NA,F
		CLRF	RX

		MOVF	PORTC,W
		MOVWF	OPX
		BTFSC	STATUS,Z
		GOTO	X_SUM
		DECFSZ	OPX,W
		GOTO	E_MD

X_RES:	MOVF	NB,W
		SUBWF	NA,W
		MOVWF	RX
		GOTO	M_R

X_SUM:	MOVF	NB,W
		ADDWF	NA,W
		MOVWF	RX
		GOTO	M_R

E_MD:	MOVF	NB,F
		BTFSC	STATUS,Z
		GOTO	M_R
		MOVF	NA,F
		BTFSC	STATUS,Z
		GOTO	M_R
		
		MOVLW	0x02
		SUBWF	OPX,W
		BTFSC	STATUS,Z
		GOTO 	X_MUL
		MOVLW	0x03
		SUBWF	OPX,W
		BTFSC	STATUS,Z
		GOTO	X_DIV
		GOTO	M_R

X_MUL:	MOVF	NA,W
		SUBWF	NB,W
		BTFSC	STATUS,C
		GOTO	NB_M
		MOVF	NA,W
		MOVWF	XB
		MOVF	NB,W
		MOVWF	XA
		GOTO	C_MUL

NB_M:	MOVF	NB,W
		MOVWF	XB
		MOVF	NA,W
		MOVWF	XA

C_MUL:	MOVF	XB,W
		ADDWF	RX,F
		DECFSZ	XA,F
		GOTO	C_MUL
		GOTO	M_R

X_DIV:	MOVF	NB,W
		SUBWF	NA,F
		BTFSS	STATUS,C
		GOTO	M_R
		INCF	RX,F
		GOTO	X_DIV

M_R:	MOVF	RX,W
		MOVWF	PORTA
		GOTO	C_P

		END
		
		