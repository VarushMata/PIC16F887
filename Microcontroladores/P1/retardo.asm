		PROCESSOR	P16F887
		INCLUDE		<P16F887.INC>
		__CONFIG _CONFIG1, (_INTRC_OSC_NOCLKOUT & _WDT_OFF & _PWRTE_OFF & _MCLRE_OFF & _CP_OFF & _CPD_OFF & _BOR_OFF & _IESO_OFF & _FCMEN_OFF & _LVP_OFF & _DEBUG_OFF)
		__CONFIG _CONFIG2, (_WRT_OFF & _BOR40V)

		VA	EQU	0x20	;ETIQUETAR RPG
		VB	EQU	0x21
		VC	EQU	0x22
		CON	EQU	0x23
     
		ORG	0x00	;VECTOR RESTAURACION
	
        BANKSEL ANSEL	;CAMBIO BANCO 3
		CLRF 	ANSEL
		CLRF 	ANSELH
	
		BANKSEL	TRISA	;CAMBIO BANCO 1
		MOVLW	0xFF
		MOVWF	TRISB
		CLRF	TRISA
		CLRF	TRISC
		CLRF	TRISD
		CLRF	TRISE
	
		BANKSEL	PORTA	;CAMBIO BANCO 0

;  CONTADOR ASCENDENTE
;C_P:	CLRF	CON
;C_I:	MOVF	CON,W
;		MOVWF	PORTA
;		CALL	RET
;		INCFSZ	CON,F
;		GOTO	C_I
;		GOTO	C_P


; CONTADOR DESCENDENTE
	
;C_P:	MOVLW	0xFF
;		MOVWF	CON
;C_I:	MOVF	CON,W
;		MOVWF	PORTA
;		CALL	RET
;		MOVLW	0x01
;		SUBWF	CON,F
;		BTFSC	STATUS,C
;		GOTO	C_I
;		GOTO	C_P

;  PRIMER PROYECTO
C_P:	MOVF	PORTB,W	;CICLO PRINCIPAL
		MOVWF	PORTA
		GOTO	C_P

RET		MOVLW	0x02
		MOVWF	VC
C_C:	MOVLW	0xFA
		MOVWF	VB
C_B:	MOVLW	0xF9
		MOVWF	VA
C_A:	NOP
		DECFSZ	VA,F
		GOTO	C_A
		DECFSZ	VB,F
		GOTO	C_B
		DECFSZ	VC,F
		GOTO	C_C
		RETURN

		END			
						