		PROCESSOR	P16F887
		INCLUDE		<P16F887.INC>

		__CONFIG _CONFIG1, (_INTRC_OSC_NOCLKOUT & _WDT_OFF & _PWRTE_OFF & _MCLRE_OFF & _CP_OFF & _CPD_OFF & _BOR_OFF & _IESO_OFF & _FCMEN_OFF & _LVP_OFF & _DEBUG_OFF)
		__CONFIG _CONFIG2, (_WRT_OFF & _BOR40V)
		
		ORG	0x00

		BANKSEL	ANSEL
		CLRF	ANSEL
		CLRF	ANSELH

		BANKSEL	TRISA

		CLRF	TRISC
		CLRF	TRISA
		MOVLW	0xFF
		MOVWF	TRISB
		CLRF	TRISD
		CLRF	TRISE
		CLRF	ADCON1
		MOVLW	0xD0
		MOVWF	OPTION_REG

		BANKSEL	PORTA
		
INICIO:	MOVF	PORTB,W
		MOVWF	PORTA
		CALL	RET
		GOTO	INICIO



RET:	MOVLW	0xD5
		MOVWF	TMR0
		BTFSS	INTCON,T0IF
		GOTO	$-1
		BCF	INTCON,T0IF
		RETURN	

		END