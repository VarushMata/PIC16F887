PROCESSOR	P16F887
		INCLUDE		<P16F887.INC>
		__CONFIG _CONFIG1, (_INTRC_OSC_NOCLKOUT & _WDT_OFF & _PWRTE_OFF & _MCLRE_OFF & _CP_OFF & _CPD_OFF & _BOR_OFF & _IESO_OFF & _FCMEN_OFF & _LVP_OFF & _DEBUG_OFF)
		__CONFIG _CONFIG2, (_WRT_OFF & _BOR40V)
VC5		EQU		0x20
VC6		EQU		0x21
VCX		EQU		0x23
		ORG		0x00	;VECTOR RESTAURACION
	
        BANKSEL ANSEL	;CAMBIO BANCO 3
        MOVLW	0x60
		MOVWF 	ANSEL
		CLRF 	ANSELH
	
		BANKSEL	TRISA	;CAMBIO BANCO 1
		MOVLW	0xFF
		MOVWF	TRISB
		CLRF	TRISC
		CLRF	TRISA
		CLRF	TRISD
		MOVLW	0x03
		MOVWF	TRISE
		CLRF	ADCON1
		MOVLW	0xD0
		MOVWF	OPTION_REG
		BANKSEL	PORTA	;CAMBIO BANCO 0
 
C_P:	MOVLW	0xD5
		MOVWF	ADCON0
		BSF		ADCON0,GO_DONE
E_C5:	BTFSC	ADCON0,GO_DONE
		GOTO	E_C5
		MOVF	ADRESH,W
		MOVWF	VC5
		BCF		ADCON0,ADON
		CALL	RET
		MOVLW	0xD9
		MOVWF	ADCON0
		BSF		ADCON0,GO_DONE
E_C6:	BTFSC	ADCON0,GO_DONE
		GOTO	E_C6
		MOVF	ADRESH,W
		MOVWF	VC6	

		BCF		ADCON0,ADON
		CALL	RET
	
		;BTFSC	PORTB,RB0 ; INTERRUPTOR AL CANAL
		;ZGOTO	MC6


		
MC5:	MOVF	VC5,W
		CALL	RX8
		MOVWF	PORTA
		MOVLW	0x0F
		MOVWF	PORTC
		CALL	RET

MC6:	MOVF	VC6,W
		CALL	RX8
		MOVWF	PORTA
		MOVLW	0xF0
		MOVWF	PORTC
		CALL	RET

		GOTO	C_P

RET:	MOVLW	0x0C
		MOVF	TMR0	
EDT0:	BTFSS	INTCON, T0IF	
		GOTO	EDT0
		BCF		INTCON, T0IF
		RETURN

RX8:	MOVWF	VCX
		MOVF	VCX,W
		SUBLW	0x20
		BTFSC	STATUS,C
		GOTO	R_1
		MOVF	VCX,W
		SUBLW	0x40
		BTFSC	STATUS,C
		GOTO	R_2
		MOVF	VCX,W
		SUBLW	0x60
		BTFSC	STATUS,C
		GOTO	R_3
		MOVF	VCX,W
		SUBLW	0x80
		BTFSC	STATUS,C
		GOTO	R_4
		MOVF	VCX,W
		SUBLW	0x9F
		BTFSC	STATUS,C
		GOTO	R_5
		MOVF	VCX,W
		SUBLW	0xBF
		BTFSC	STATUS,C
		GOTO	R_6
		MOVF	VCX,W
		SUBLW	0xDF
		BTFSC	STATUS,C
		GOTO	R_7
R_8:	RETLW	0xFF
R_7:	RETLW	0x7F
R_6:	RETLW	0x3F
R_5:	RETLW	0x1F
R_4:	RETLW	0x0F
R_3:	RETLW	0x07
R_2:	RETLW	0x03
R_1:	RETLW	0x01
		RETURN


		
		END