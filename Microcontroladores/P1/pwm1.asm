;PWM		
		PROCESSOR   P16F887
		INCLUDE	    <P16F887.INC>
	
		__CONFIG _CONFIG1, (_INTRC_OSC_NOCLKOUT & _WDT_OFF & _PWRTE_OFF & _MCLRE_OFF & _CP_OFF & _CPD_OFF & _BOR_OFF & _IESO_OFF & _FCMEN_OFF & _LVP_OFF & _DEBUG_OFF)
		__CONFIG _CONFIG2, (_WRT_OFF & _BOR40V)

T_AL	EQU		0x20
			
		ORG		0x00		;VECTOR DE RESTAURACION
	
		BANKSEL	ANSEL
		MOVLW	0x60		;CH5 Y CH6
		MOVWF	ANSEL
		CLRF	ANSELH
	
		BANKSEL	TRISA
		MOVLW	0xFF
		MOVWF	TRISC
		CLRF	TRISA
		CLRF	TRISC		;SALIDA RC1 CCP1; RC2 CCP1/P1A
		CLRF	TRISD
		MOVLW	0x03
		MOVWF	TRISE		;CH5 Y CH6
	
		CLRF	ADCON1		;JUSTIFICACIсN IZQ REF ALIMENTACIсN
		MOVLW	.255		;255
		MOVWF	PR2
		MOVLW	0xD0	
		MOVWF	OPTION_REG
	
		BANKSEL	PORTA
	
		MOVLW	0x80		;1000000000
		MOVWF	CCPR1L		;DC 50% 512 => CCPR1L:CCP1CON<5:4> 0b10000000 00
		MOVWF	CCPR2L		
	
		MOVLW	0x0C		;P1M<10>:00 P1A MODULATED; DC1B<1:0>:00; CCP1M<3:0>:PWM
		MOVWF	CCP1CON
		MOVWF	CCP2CON
	
						;TMR2 PreE T2CKPS<1:0> 16 11; TOUTPS<3:1> 1:1 0000
		BSF		T2CON,1
		BSF		T2CON, TMR2ON	;ENCENDER TMR2
E_IP	BTFSS	PIR1, TMR2IF	;ESPERAR INICIO PERIODO
		GOTO	E_IP

		BANKSEL	TRISA
		CLRF	TRISC
		BANKSEL	PORTA
	
C_P		MOVLW	0xD5		;SELECCIONAR C0
		MOVWF	ADCON0

		BSF		ADCON0, GO_DONE		
E_C5	BTFSC	ADCON0, GO_DONE
		GOTO	E_C5
		MOVF	ADRESH, W
		MOVWF	CCPR1L
		CALL	R_AL
		MOVWF	CCP1CON
		BCF		ADCON0, ADON
		CALL	RET

		MOVLW	0xD9		;SELECCIONAR C1
		MOVWF	ADCON0
	
		BSF		ADCON0, GO_DONE		
E_C6	BTFSC	ADCON0, GO_DONE
		GOTO	E_C6
		MOVF	ADRESH, W
		MOVWF	CCPR2L
		CALL	R_AL
		MOVWF	CCP2CON
		BCF		ADCON0, ADON
		CALL	RET
		GOTO	C_P	
				
R_AL	
		BANKSEL	TRISA
		MOVF	ADRESL,W
		BANKSEL	PORTA
		MOVWF	T_AL
		BCF		STATUS,C
		RRF		T_AL,F
		RRF		T_AL,F
		MOVLW	0x0C		;0000 1100
		IORWF	T_AL,W
		RETURN
	
;******RETARDO POR TIMER 0 
		
RET:	MOVLW	0xD5
		MOVWF	TMR0
		BTFSS	INTCON,T0IF
		GOTO	$-1
		BCF		INTCON,T0IF
		RETURN	

		END