;*******************************************************	    
SUBT1V	    MACRO	VAR1
	    MOVLW	VAR1
	    MOVWF	0X60
	    CALL	ST1V
	    ENDM
;*******************************************************	    
SUBT2V	    MACRO	VAR1,VAR2
	    MOVLW	VAR2
	    MOVWF	0X61
	    MOVLW	VAR1
	    MOVWF	0X62
	    CALL	ST2V
	    ENDM
;*******************************************************	    
SUBT3V	    MACRO	VAR1,VAR2,VAR3
	    MOVLW	VAR1
	    MOVWF	0X64
	    MOVLW	VAR2
	    MOVWF	0X65
	    MOVLW	VAR3
	    MOVWF	0X66
	    CALL	ST3V
	    ENDM
;*******************************************************		
		
		PROCESSOR	P16F887
		INCLUDE		<P16F887.INC>

		__CONFIG _CONFIG1, (_INTRC_OSC_NOCLKOUT & _WDT_OFF & _PWRTE_OFF & _MCLRE_OFF & _CP_OFF & _CPD_OFF & _BOR_OFF & _IESO_OFF & _FCMEN_OFF & _LVP_OFF & _DEBUG_OFF)
		__CONFIG _CONFIG2, (_WRT_OFF & _BOR40V)
		
		ORG	0x00
		
#DEFINE		UNID_E	BSF PORTC,0
#DEFINE		UNID_A	BCF PORTC,0
#DEFINE		DECE_E	BSF PORTC,1
#DEFINE		DECE_A	BCF PORTC,1
#DEFINE		CENTE_E	BSF PORTC,2
#DEFINE		CENTE_A	BCF PORTC,2
#DEFINE		MILL_E	BSF PORTC,3
#DEFINE		MILL_A	BCF PORTC,3

UNID		EQU	0x20
DECE		EQU	0x21
CENT		EQU	0x22
MILL		EQU	0x23
CONT60		EQU	0x24
UWU			EQU	0x25
CT			EQU	0x26
		

		BANKSEL ANSEL	;CAMBIO BANCO 3
		CLRF 	ANSEL
		CLRF 	ANSELH
	
		BANKSEL	TRISA	;CAMBIO BANCO 1
		CLRF	TRISB
		CLRF	TRISA
		CLRF	TRISC
		CLRF	TRISD
		CLRF	TRISE
		MOVLW	0xD5
		MOVWF	OPTION_REG
		

		BANKSEL	PORTA	;CAMBIO BANCO 0	
		
		CLRF	PORTA
		CLRF	PORTB


		MOVLW	0x01
		MOVWF	UWU
	
	
LIMPIAMIL:	CLRF	MILL
LIMPIACEN:	CLRF	CENT
LIMPIADEC:	CLRF	DECE
LIMPIAUNI:	CLRF	UNID
REC60:
		
		MOVLW	.57
		MOVWF	CONT60
		SUBT3V	.162,.1,.1
		NOP
		
		

		DECFSZ	UWU,W
		GOTO	CAMBIA
		MOVLW	0x00
		MOVWF	UWU	
		GOTO	DESPLEGADO

CAMBIA:	MOVLW	0x01
		MOVWF	UWU	
	
DESPLEGADO:
		MOVF	UNID,W
		CALL	SIETESEG
		MOVWF	PORTA
		UNID_E	
		CALL	RET
		UNID_A
		
		MOVF	DECE,W
		CALL	SIETESEG
		MOVWF	PORTA
		DECE_E
		CALL	RET
		DECE_A
		
		DECFSZ	UWU,W
		GOTO	NOPUNTO
		MOVF	CENT,W
		CALL	SIETESEG
		MOVWF	PORTA
		CENTE_E
		BCF		PORTA,7
		CALL	RET
		CENTE_A
		GOTO	CONTINUE		

NOPUNTO:
		MOVF	CENT,W
		CALL	SIETESEG
		MOVWF	PORTA
		CENTE_E
		BSF		PORTA,7
		CALL	RET
		CENTE_A

CONTINUE:
		MOVF	MILL,W
		CALL	SIETESEG
		MOVWF	PORTA
		MILL_E
		CALL	RET
		MILL_A	
		
		DECFSZ	CONT60,F
		GOTO	DESPLEGADO
		

		INCF	UNID,F
		MOVLW	0x0A
		XORWF	UNID,W
		BTFSS	STATUS,Z
		GOTO	REC60
		
		INCF	DECE,F
		MOVLW	0x06
		XORWF	DECE,W
		BTFSS	STATUS,Z
		GOTO	LIMPIAUNI
		
		INCF	CENT,F
		MOVLW	0x0A
		XORWF	CENT,W
		BTFSS	STATUS,Z
		GOTO	LIMPIADEC
		
		INCF	MILL,F
		MOVLW	0x0A
		XORWF	MILL,W
		BTFSS	STATUS,Z
		GOTO	LIMPIACEN
		GOTO	LIMPIAMIL

	
SIETESEG:	
		ADDWF	PCL,F
		RETLW	0x3F 
		RETLW	0x06
		RETLW	0x5B
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		RETLW	0x6F 
		
RET:	MOVLW	.188		;189 MАs funcional hasta ahora
		MOVWF	TMR0
EDT0:	BTFSS	INTCON,T0IF
		GOTO	EDT0
		BCF		INTCON,T0IF
		RETURN
;**********************************************************************	
ST1V:		NOP
		NOP
		NOP
		NOP
		DECFSZ	    0X60,F
		GOTO	    ST1V
		RETURN
;**********************************************************************			
ST2V:		MOVF	    0X62,W
		MOVWF	    0X63
DECRE2V:	NOP
		NOP
		NOP
		NOP
		DECFSZ	    0X63,F
		GOTO	    DECRE2V
		DECFSZ	    0X61,F
		GOTO	    ST2V
		RETURN
;**********************************************************************		
ST3V:		MOVF	    0X66,W
		MOVWF	    0X67
RECARGA3V:	MOVWF	    0X68
DECRE3V:	NOP
		NOP
		NOP
		NOP
		DECFSZ	    0X68,F
		GOTO	    DECRE3V
		DECFSZ	    0X67,F
		GOTO	    RECARGA3V
		DECFSZ	    0X64,F
		GOTO	    ST3V
		RETURN
	   
		END


	END
	    