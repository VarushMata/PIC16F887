INCLUDE	    <P16F887.INC>

	__CONFIG _CONFIG1, (_INTRC_OSC_NOCLKOUT & _WDT_OFF & _PWRTE_OFF & _MCLRE_OFF & _CP_OFF & _CPD_OFF & _BOR_OFF & _IESO_OFF & _FCMEN_OFF & _LVP_OFF & _DEBUG_OFF)
	__CONFIG _CONFIG2, (_WRT_OFF & _BOR40V)

XU		EQU	    0x21	
XD      EQU	    0x22
XC      EQU	    0x23
XM      EQU	    0x24
;VC      EQU	    0x25
;VB      EQU	    0x26
;VA      EQU	    0x27
CX		EQU	    0x28
NX		EQU		0x29
SU		EQU		0x30
SD		EQU		0x31
SC		EQU		0x32
SM		EQU		0x33

	ORG	    0x00	

	BANKSEL	    ANSEL	
	CLRF	    ANSEL
	CLRF	    ANSELH

	BANKSEL	    TRISA	
	MOVLW	    0xFF
	MOVWF	    TRISB
	CLRF	    TRISA
	CLRF	    TRISC
	CLRF		TRISD
	CLRF	    TRISE
	MOVLW	    0XD0
	MOVWF	    OPTION_REG

	BANKSEL	    PORTA	
	CLRF	    PORTA
	CLRF	    TMR0

RXM		CLRF	XM
RXC		CLRF	XC
RXD		CLRF	XD
RXU		CLRF	XU

S_N		MOVLW	0x05	;selecciona unidades
		MOVWF	SU	
		MOVLW	0x07	;selecciona decenas
		MOVWF	SD
		MOVLW	0x01	;selecciona centenas
		MOVWF	SC
		MOVLW	0x02	;selecciona millares
		MOVWF	SM



RNX		MOVLW	0x3C
		MOVWF	NX		

C_P		MOVF	XU,W
		CALL	T7S
		MOVWF	PORTA
		MOVLW	0x01
		MOVWF	PORTC	
		CALL	RET		

		MOVF	XD,W
		CALL	T7S
		MOVWF	PORTA
		MOVLW	0x02
		MOVWF	PORTC	
		CALL	RET		

		MOVF	XC,W
		CALL	T7S
		MOVWF	PORTA
		MOVLW	0x04
		MOVWF	PORTC	
		CALL	RET		

		MOVF	XM,W
		CALL	T7S
		MOVWF	PORTA
		MOVLW	0x08
		MOVWF	PORTC	
		CALL	RET		
		DECFSZ	NX,F

		
		GOTO	C_N

		INCF	XU,F
		MOVLW	0x0A
		SUBWF	XU,W
		BTFSS	STATUS,Z
		GOTO	RNX
		
		
		INCF	XD,F
		MOVLW	0x0A
		SUBWF	XD,W
		BTFSS	STATUS,Z
		GOTO	RXU

		INCF	XC,F
		MOVLW	0x0A
		SUBWF	XC,W
		BTFSS	STATUS,Z
		GOTO	RXD

		INCF	XM,F
		MOVLW	0x0A
		SUBWF	XM,W
		BTFSS	STATUS,Z
		GOTO	RXC
		GOTO	RXM


T7S		ADDWF	PCL,F
		RETLW	0x3F
		RETLW	0x06
		RETLW	0x5B
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		RETLW	0x67





RET		MOVLW	0X30
		MOVWF	TMR0
E_T0X	BTFSS	INTCON,T0IF
		GOTO	E_T0X
		BCF	INTCON,T0IF
		RETURN

C_N		MOVF	XM,W
		SUBWF	SM,W
		BTFSS	STATUS,Z
		GOTO	C_P

		MOVF	XC,W
		SUBWF	SC,W
		BTFSS	STATUS,Z
		GOTO	C_P

		MOVF	XD,W
		SUBWF	SD,W
		BTFSS	STATUS,Z
		GOTO	C_P			
		
		MOVF	XU,W
		SUBWF	SU,W
		BTFSS	STATUS,Z
		GOTO	C_P
		GOTO	M_R

M_R		MOVF	XU,W
		CALL	T7S
		MOVWF	PORTA
		MOVLW	0x01
		MOVWF	PORTC
		CALL	RET

		MOVF	XD,W
		CALL	T7S
		MOVWF	PORTA
		MOVLW	0x02
		MOVWF	PORTC
		CALL	RET

		MOVF	XC,W
		CALL	T7S
		MOVWF	PORTA
		MOVLW	0x04
		MOVWF	PORTC
		CALL	RET

		MOVF	XM,W
		CALL	T7S
		MOVWF	PORTA
		MOVLW	0x08
		MOVWF	PORTC
		CALL	RET

		GOTO	M_R
		
		END