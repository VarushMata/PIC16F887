PROCESSOR	P16F887
		INCLUDE		<P16F887.INC>

__CONFIG _CONFIG1, (_INTRC_OSC_NOCLKOUT & _WDT_OFF & _PWRTE_OFF & _MCLRE_OFF & _CP_OFF & _CPD_OFF & _BOR_OFF & _IESO_OFF & _FCMEN_OFF & _LVP_OFF & _DEBUG_OFF)
__CONFIG _CONFIG2, (_WRT_OFF & _BOR40V)

NB	    EQU     0x21	
WM	    EQU     0x22
VA		EQU		0x23
VB		EQU		0x24
VC		EQU		0x25
;VX		EQU		0x20
      
		ORG	0x00	
	
        BANKSEL ANSEL	;CAMBIO BANCO 3
		CLRF 	ANSEL
		CLRF 	ANSELH
	
		BANKSEL	TRISA	;CAMBIO BANCO 1
		CLRF	TRISA	
		MOVLW	0xFF
		MOVWF	TRISB
		CLRF	TRISC
		CLRF	TRISD
		CLRF	TRISE
	
		BANKSEL	PORTA	;CAMBIO BANCO 0

NINGUNO	MOVF	PORTB,W
		ANDLW	0X0F
		MOVWF	NB
		MOVLW	0X0F
		XORWF	NB,W
		BTFSC	STATUS,Z
		CALL	W_4
		MOVLW	0X07
		XORWF	NB,W
		BTFSC	STATUS,Z
		CALL	W_16
		MOVLW	0X03
		XORWF	NB,W
		BTFSC	STATUS,Z
		CALL	W_32
		MOVLW	0X01
		XORWF	NB,W
		BTFSC	STATUS,Z
		CALL	W_64
		GOTO	NINGUNO

;SUBRUTINA PARA VELOCIDAD 2s POR CADA RETARDO
W_64	MOVLW	0X08
		MOVWF	WM
		BTFSC	PORTB,7
		CALL	GIRO_D
		BTFSC	PORTB,7
		GOTO	RE_1
		CALL	GIRO_I
RE_1	RETURN
		
;SUBRUTINA PARA VELOCIDAD 2s POR CADA RETARDO
W_32	MOVLW	0X04
		MOVWF	WM
		BTFSC	PORTB,7
		CALL	GIRO_D
		BTFSC	PORTB,7
		GOTO	RE_2
		CALL	GIRO_I
RE_2	RETURN

;SUBRUTINA PARA VELOCIDAD 2s POR CADA RETARDO
W_16	MOVLW	0X02
		MOVWF	WM
		BTFSC	PORTB,7
		CALL	GIRO_D
		BTFSC	PORTB,7
		GOTO	RE_3
		CALL	GIRO_I
RE_3	RETURN


W_4		MOVLW	0X01
		MOVWF	WM
		BTFSC	PORTB,7
		CALL	GIRO_D
		BTFSC	PORTB,7
		GOTO	RE_4
		CALL	GIRO_I
RE_4	RETURN


GIRO_I	MOVLW	0X09
		MOVWF	PORTA
		CALL	RET
		MOVLW	0X03
		MOVWF	PORTA
		CALL	RET
		MOVLW	0X06
		MOVWF	PORTA
		CALL	RET
		MOVLW	0X0C
		MOVWF	PORTA
		CALL	RET
		RETURN

;SUBRUTINA GIRO DERECHA
GIRO_D	MOVLW	0X0C
		MOVWF	PORTA
		CALL	RET
		MOVLW	0X06
		MOVWF	PORTA
		CALL	RET
		MOVLW	0X03
		MOVWF	PORTA
		CALL	RET
		MOVLW	0X09
		MOVWF	PORTA
		CALL	RET
		RETURN
		

RET		MOVF	WM,W	
		MOVWF	VC
C_VC	MOVLW	0xFA
		MOVWF	VB
C_VB	MOVLW	0xF9
		MOVF	VA
C_VA	DECFSZ	VA,F
		GOTO	C_VA
		DECFSZ	VB,F	
		GOTO 	C_VB
		DECFSZ	VC,F
		GOTO	C_VC
		RETURN


		END