PROCESSOR	P16F887
	INCLUDE		<P16F887.INC>

__CONFIG _CONFIG1, (_INTRC_OSC_NOCLKOUT & _WDT_OFF & _PWRTE_OFF & _MCLRE_OFF & _CP_OFF & _CPD_OFF & _BOR_OFF & _IESO_OFF & _FCMEN_OFF & _LVP_OFF & _DEBUG_OFF)
__CONFIG _CONFIG2, (_WRT_OFF & _BOR40V)

		ORG	0x00	;VECTOR RESTAURACION
MB1		EQU	0x00
XX		EQU	0x00
CT		EQU	0x00 
EB1		EQU	0x00
	
  ORG	0x00
    	BANKSEL ANSEL	;CAMBIO BANCO 3
    	MOVLW	0X00 ; 96     11000000
    	MOVWF 	ANSEL
   	 	CLRF 	ANSELH
	
    	BANKSEL	TRISA
    	MOVLW	0xFF	 ; 255	11111111
    	MOVLW	0XC0
    	MOVWF	SSPSTAT

    	CLRF TRISA
    	MOVLW 0XFF
    	MOVWF	TRISB
    	MOVLW	0X10
    	MOVWF	 TRISC
    	CLRF	TRISD
  	  	MOVLW	0X07
   	 	MOVWF	TRISE
    	MOVLW	    0XD2
 		MOVWF	    OPTION_REG
 		CLRF	ADCON1
 		MOVLW	0XFF	; 255	11111111
 		MOVWF	PR2
	
   		BANKSEL PORTA
  		MOVLW 0X30
    	MOVWF SSPCON

CM		MOVF	PORTB,W ;PROCESO
		MOVWF	MB1
		MOVF	EB1,W
		MOVWF	PORTA
		CALL	R1MS
	
		MOVF	MB1,W	;SPI
		CALL	MSPI
		MOVWF	XX
	
		MOVF	XX,W
		CALL	MSPI
		MOVWF	EB1
		GOTO	CM

;CM		MOVF	PORTB,W ;PROCESO
;		MOVWF	EB1
;		MOVF	MB1,W
;		MOVWF	PORTA
;	
;		MOVF	EB1,W	;SPI
;		CALL	ESPI
;		MOVWF	MB1
;	
;		MOVF	XX,W
;		CALL	ESPI
;		MOVWF	XX
;		GOTO	CM


MSPI	BCF		PORTA,RA5
		MOVWF	SSPBUF
		BANKSEL	TRISA
EBF		BTFSS	SSPSTAT,BF
		GOTO	EBF
		BANKSEL	PORTA
		BSF		PORTA,RA5
		MOVF	SSPBUF,W
		RETURN


;ESPI	MOVWF	X1
;		BANKSEL	TRISA
;EBF		BTFSS	SSPSTAT,BF
;		GOTO	EBF
;		BANKSEL	PORTA
;	
;		MOVF	SSPBUF,W
;		MOVWF	X2
;		MOVF	X1,W
;		MOVWF	SSPBUF
;		MOVF	X2,W
;		RETURN

R1MS	MOVLW	0x7A	
		MOVWF	CT
C_IR	CLRF	TMR0
EB6X	BTFSS	TMR0,6
		GOTO	EB6X
		DECFSZ	CT,F
		GOTO	C_IR
		RETURN
		
		END