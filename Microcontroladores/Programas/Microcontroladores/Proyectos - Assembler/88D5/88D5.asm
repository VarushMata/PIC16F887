INCLUDE	    <P16F887.INC>

	__CONFIG _CONFIG1, (_INTRC_OSC_NOCLKOUT & _WDT_OFF & _PWRTE_OFF & _MCLRE_OFF & _CP_OFF & _CPD_OFF & _BOR_OFF & _IESO_OFF & _FCMEN_OFF & _LVP_OFF & _DEBUG_OFF)
	__CONFIG _CONFIG2, (_WRT_OFF & _BOR40V)

	CUENTA	EQU		0x22
	O		EQU		0x23
	M		EQU		0x24
	N		EQU		0x25

	ORG	    0x00	

	BANKSEL	    ANSEL	
	CLRF	    ANSEL
	CLRF	    ANSELH

	BANKSEL	    TRISA	
	MOVLW	    0xFF
	MOVWF	    TRISB
	CLRF	    TRISA
	CLRF	    TRISC
	CLRF		TRISD
	CLRF	    TRISE
	MOVLW	    0XD4
	MOVWF	    OPTION_REG

	BANKSEL	    PORTA	
	CLRF	    PORTA
	CLRF		PORTC
	CLRF	    TMR0
	MOVLW		D'30'
	MOVWF		CUENTA

C_P		
CO
		MOVLW	0x40
		MOVWF	PORTA
		MOVLW	0x66
		MOVWF	PORTC
		CALL	RET
		MOVLW	0x30
		MOVWF	PORTA
		MOVLW	0xFF
		MOVWF	PORTC
		CALL	RET
		MOVLW	0x08
		MOVWF	PORTA
		MOVLW	0x7E
		MOVWF	PORTC
		CALL	RET
		MOVLW	0x04
		MOVWF	PORTA
		MOVLW	0x3C
		MOVWF	PORTC
		CALL	RET
		MOVLW	0x02
		MOVWF	PORTA
		MOVLW	0x18
		MOVWF	PORTC
		CALL	RET
		DECFSZ	CUENTA,1
		GOTO	CO

		MOVLW	D'30'
		MOVWF	CUENTA

FE
		MOVLW	0x56
		MOVWF	PORTA
		MOVLW	0x23
		MOVWF	PORTC
		CALL	RET
		MOVLW	0x81
		MOVWF	PORTA
		MOVLW	0xA3
		MOVWF	PORTC
		CALL	RET
		MOVLW	0x24
		MOVWF	PORTA
		MOVLW	0x05
		MOVWF	PORTC
		CALL	RET
		DECFSZ	CUENTA,1
		GOTO	FE

		MOVLW	D'30'
		MOVWF	CUENTA

		GOTO	C_P
RET
		MOVLW	D'1'
		MOVWF	O
TRES	
		MOVLW	D'7'
		MOVWF	M
DOS
		MOVLW	D'100'
		MOVWF	N
UNO		
		NOP
		NOP
		DECFSZ N,1
		GOTO	UNO
		DECFSZ	M,1
		GOTO	DOS
		DECFSZ	O,1
		GOTO	TRES
		RETURN
		
		END