PROCESSOR	P16F887
	INCLUDE		<P16F887.INC>

__CONFIG _CONFIG1, (_INTRC_OSC_NOCLKOUT & _WDT_OFF & _PWRTE_OFF & _MCLRE_OFF & _CP_OFF & _CPD_OFF & _BOR_OFF & _IESO_OFF & _FCMEN_OFF & _LVP_OFF & _DEBUG_OFF)
__CONFIG _CONFIG2, (_WRT_OFF & _BOR40V)

CT   	EQU		0x20
;NA   	EQU   	0x21
;NB  	EQU   	0x22
;RX   	EQU   	0x23
;OPX 	EQU   	0x24
;XA   	EQU   	0x25
;
;XB   	EQU   	0x26
     
		ORG	0x00	;VECTOR RESTAURACION
	
   		BANKSEL ANSEL	;CAMBIO BANCO 3
		CLRF 	ANSEL
		CLRF 	ANSELH
	
		BANKSEL	TRISA	;CAMBIO BANCO 1
		MOVLW	0xFF
		MOVF	TRISB
		CLRF	TRISA
		MOVLW	0x07
		CLRF	TRISC
		CLRF	TRISD
		CLRF	TRISE
		MOVLW	0xD6
		MOVWF	OPTION_REG

		BANKSEL	PORTA	;CAMBIO BANCO 0

;C_P		MOVLW	0xFF
;		MOVWF	PORTA
;		CALL	RET_D	
;		MOVLW	0x00
;		MOVWF	PORTA
;		CALL	RET_D
;		GOTO	C_P

C_P		MOVLW	0X01
		MOVWF	PORTA
		CALL	RET_D
		MOVLW	0X02
		MOVWF	PORTA
		CALL	RET_D
		MOVLW	0X04
		MOVWF	PORTA
		CALL	RET_D
		MOVLW	0X08
		MOVWF	PORTA			
		CALL	RET_D
		MOVLW	0X10
		MOVWF	PORTA			
		CALL	RET_D
		MOVLW	0X20
		MOVWF	PORTA			
		CALL	RET_D
		MOVLW	0X40
		MOVWF	PORTA			
		CALL	RET_D
		MOVLW	0X80
		MOVWF	PORTA			
		CALL	RET_D
		MOVLW	0X40
		MOVWF	PORTA
		CALL	RET_D
		MOVLW	0X20
		MOVWF	PORTA
		CALL	RET_D
		MOVLW	0X10
		MOVWF	PORTA
		CALL	RET_D
		MOVLW	0X08
		MOVWF	PORTA
		CALL	RET_D
		MOVLW	0X04
		MOVWF	PORTA			
		CALL	RET_D
		MOVLW	0X02
		MOVWF	PORTA			
		CALL	RET_D
		GOTO 	C_P		

;RET_A	CLRF	TMR0
;ET0IF	BTFSS	INTCON, T0IF	
;		GOTO ET0IF
;		BCF	INTCON, T0IF
;		RETURN
;
;RET_B	MOVLW	0x9C
;		MOVWF	TMR0
;ET0IFX	BTFSS	INTCON, T0IF
;		GOTO	ET0IFX
;		BCF	INTCON, T0IF
;		RETURN
;
;RET_C	CLRF	TMR0
;EB6	BTFSS	TMR0,6
;		GOTO	EB6
;		RETURN

RET_D	MOVLW	0x7A	
		MOVWF	CT
C_IR	CLRF	TMR0
EB6X	BTFSS	TMR0,6
		GOTO	EB6X
		DECFSZ	CT,F
		GOTO	C_IR
		RETURN

		END