PROCESSOR	P16F887
		INCLUDE		<P16F887.INC>

		__CONFIG _CONFIG1, (_INTRC_OSC_NOCLKOUT & _WDT_OFF & _PWRTE_OFF & _MCLRE_OFF & _CP_OFF & _CPD_OFF & _BOR_OFF & _IESO_OFF & _FCMEN_OFF & _LVP_OFF & _DEBUG_OFF)
		__CONFIG _CONFIG2, (_WRT_OFF & _BOR40V)
		
		ORG		0x00
CON 	EQU 0X20

		ORG		0X00
		GOTO	INICIO		
		ORG		0X04
		GOTO	S_AI

INICIO	ORG		0X05
		BANKSEL	ANSEL
		CLRF	ANSEL
		CLRF	ANSELH
		
		BANKSEL	TRISA
		CLRF	TRISA
		MOVLW	B'11110001'
		MOVWF	TRISB
		MOVLW	B'11110000'		
		MOVWF	IOCB
		CLRF	TRISC
		CLRF	TRISD
		CLRF	TRISE
		MOVLW	B'11010110'
		MOVLW	OPTION_REG
		
		BANKSEL	PORTA
		MOVLW	B'10011000'
		MOVWF	INTCON
		CLRF	PORTA


C_P		GOTO	C_P

S_AI	BTFSC	INTCON,INTF
		GOTO	PARAR
		CLRF	PORTB
		MOVLW	B'10011000'
		MOVWF	INTCON
		;BCF	INTCON,RBIF
ALARMA	MOVLW	B'00000001'
		MOVWF	PORTA
		CALL	TIME
		MOVLW	B'00000010'
		MOVWF	PORTA
		CALL	TIME
		GOTO	ALARMA
PARAR	CLRF	PORTA
		MOVLW	B'10011000'
		MOVWF	INTCON
		;BCF	INTCON,INTF
		GOTO	C_P


TIME	MOVLW	D'217'
		MOVWF	CON
CEB6	CLRF	TMR0
EB6		BTFSS	TMR0,6
		GOTO	EB6
		DECFSZ	CON,F
		GOTO	CEB6
		RETURN

		END