PROCESSOR	P16F887
		INCLUDE		<P16F887.INC>

		__CONFIG _CONFIG1, (_INTRC_OSC_NOCLKOUT & _WDT_OFF & _PWRTE_OFF & _MCLRE_OFF & _CP_OFF & _CPD_OFF & _BOR_OFF & _IESO_OFF & _FCMEN_OFF & _LVP_OFF & _DEBUG_OFF)
		__CONFIG _CONFIG2, (_WRT_OFF & _BOR40V)
		
		ORG	0x00
		
VC5		EQU	0x20
VC6		EQU	0x21

		BANKSEL	ANSEL
		MOVLW	0x60
		MOVWF	ANSEL
		CLRF	ANSELH

		BANKSEL	TRISA
		CLRF	TRISB
		CLRF	TRISA
		MOVLW	0xFF
		MOVWF	TRISC
		CLRF	TRISD
		MOVLW	0x03
		MOVWF	TRISE
		CLRF	ADCON1
		MOVLW	0xD0
		MOVWF	OPTION_REG
		
		
;**** CONFIGURACIсN DEL PWM****
		MOVLW	.250	;CON PRESCALER DEL TIMER2 = 4 SE OBTIENE 1kHZ 
		MOVWF	PR2
		BANKSEL	PORTA	;CAMBIO BANCO 0
		BSF	T2CON,T2CKPS0	;PRESCALER DEL TIMER2 = 4
		BSF	CCP2CON,3
		BSF	CCP2CON,2	;SE SELECCIONA AL PWM
		CLRF	CCPR2L		;PCU DEL PWM AL O%
		BCF	PIR1,TMR2IF
		BSF	T2CON,TMR2ON
		BTFSS	PIR1,TMR2IF
		GOTO	$-1
;****** CONFIGURACIсN DEL PWM MEJORADO
		BSF	T2CON,T2CKPS0	;PRESCALER DEL TIMER2 = 4
		BSF	CCP1CON,3
		BSF	CCP1CON,2	;SE SELECCIONA AL PWM
		CLRF	CCPR1L		;PCU DEL PWM AL O%
		BCF	PIR1,TMR2IF
		BSF	T2CON,TMR2ON
		BTFSS	PIR1,TMR2IF
		GOTO	$-1
		BANKSEL	TRISA
		BCF	TRISC,2
		BCF	TRISC,1
		BANKSEL	PORTA
;*******************************
C_P:		MOVLW	0xD5
		MOVWF	ADCON0
		BSF	ADCON0,GO_DONE
		BTFSC	ADCON0,GO_DONE
		GOTO	$-1
		MOVF	ADRESH,W
		MOVWF	VC5

		BSF	ADCON0,ADON
		CALL	RET
	
		MOVLW	0xD9
		MOVWF	ADCON0
		BSF	ADCON0,GO_DONE
		BTFSC	ADCON0,GO_DONE
		GOTO	$-1
		MOVF	ADRESH,W
		MOVWF	VC6
		
		MOVF	VC5,W
		MOVWF	CCPR1L
		MOVF	VC6,W
		MOVWF	CCPR2L
		GOTO	C_P
		
		
;************RETARDO POR TIMER 0 
		
RET:		MOVLW	0xD5
		MOVWF	TMR0
		BTFSS	INTCON,T0IF
		GOTO	$-1
		BCF	INTCON,T0IF
		RETURN	

		END